## arch/riscv/configs/rocket-chip-zcu102_defconfig
```kconfig
# arch config
CONFIG_64BIT=y
CONFIG_RISCV=y
CONFIG_RISCV_UINTR=y
CONFIG_MMU=y
CONFIG_SMP=y

# platform config
CONFIG_SOC_ROCKET_CHIP_ZCU102=y
CONFIG_SIFIVE_PLIC=y

# serial
CONFIG_SERIAL_8250=y
CONFIG_SERIAL_8250_CONSOLE=y
CONFIG_SERIAL_OF_PLATFORM=y
CONFIG_HVC_RISCV_SBI=y

# init ramdisk
CONFIG_BLK_DEV_INITRD=y
CONFIG_INITRAMFS_SOURCE="../buildroot/output/images/rootfs.cpio"

# dev tmpfs
CONFIG_DEVTMPFS=y
CONFIG_DEVTMPFS_MOUNT=y

# useful fs
CONFIG_PROC_FS=y
CONFIG_SYSFS=y
CONFIG_TMPFS=y

# others
CONFIG_PRINTK_TIME=y
CONFIG_EMBEDDED=y

# speedup booting
CONFIG_LEGACY_PTY_COUNT=4
CONFIG_NR_CPUS=2

# reduce size
CONFIG_CC_OPTIMIZE_FOR_SIZE=y
```
